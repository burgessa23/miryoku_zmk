// Copyright 2022 Manna Harbour
// https://github.com/manna-harbour/miryoku
#include <dt-bindings/zmk/mouse.h>
#include <behaviors/num_word.dtsi>
#include <input/processors.dtsi>
#include "../miryoku/custom_config.h"
#include "../miryoku/mapping/38/totem.h"
#include "../miryoku/miryoku.dtsi"
// #define ZMK_HELPERS_KEEP_NATIVE 1
// #include "zmk-helpers/helper.h"
// #include "zmk-helpers/key-labels/hillside46.h"

&sk {  // sticky-key config
    release-after-ms = <900>;  // release after 0.6s
    quick-release;             // no double capitalization when rolling keys
};

&sl {  // sticky-layer config
    ignore-modifiers;          // allow chording sticky mods & layers
};

&lt {  // layer-tap config
    flavor = "balanced";
    tapping-term-ms = <200>;
    quick-tap-ms = <QUICK_TAP_MS>;
};

/* Homerow mods */

  // ╭────────────────────────╮               ╭────────────────────────╮
  // │  0   1   2   3   4   5 │               │  6   7   8   9  10  11 │
  // │ 12  13  14  15  16  17 ╰──╮         ╭──╯ 18  19  20  21  22  23 │
  // │ 24  25  26  27  28  29  30╰────┬────╯31  32  33  34  35  36  37 │
  // ╰───────────────╮ 38  39  40  41 │ 42  43  44  45 ╭───────────────╯
  //                 ╰────────────────┴────────────────╯
  //
#define LHKEYS 0 1 2 3 4 5 12 13 14 15 16 17 24 25 26 27 28 29 30
#define RHKEYS 6 7 8 9 10 11 18 19 20 21 22 23 31 32 33 34 35 36 37
#define THKEYS 38 39 40 41 42 43 44 45
// #define KEYS_L LT0 LT1 LT2 LT3 LT4 LM0 LM1 LM2 LM3 LM4 LB0 LB1 LB2 LB3 LB4  // left hand
// #define KEYS_R RT0 RT1 RT2 RT3 RT4 RM0 RM1 RM2 RM3 RM4 RB0 RB1 RB2 RB3 RB4  // right hand
// #define THUMBS LH2 LH1 LH0 RH0 RH1 RH2                                      // thumbs
//
#define MAKE_HRM(NAME, HOLD, TAP, TRIGGER_POS) \
    ZMK_HOLD_TAP(NAME, \
        flavor = "balanced"; \
        tapping-term-ms = <200>; \
        quick-tap-ms = <200>; \
        require-prior-idle-ms = <125>; \
        bindings = <HOLD>, <TAP>; \
        hold-trigger-key-positions = <TRIGGER_POS>; \
        hold-trigger-on-release; \
    )

MAKE_HRM(hml, &kp, &kp, KEYS_R THUMBS)  // left-hand HRMs
MAKE_HRM(hmr, &kp, &kp, KEYS_L THUMBS)  // right-hand HRMs

MAKE_HRM(hml_repeat, &kp, &key_repeat, KEYS_R THUMBS)  // used for HRM-combo
MAKE_HRM(hmr_lpar_lt, &kp, &lpar_lt, KEYS_L THUMBS)    // "    "   "   "
MAKE_HRM(hmr_rpar_gt, &kp, &rpar_gt, KEYS_L THUMBS)    // "    "   "   "

/* Homerow retro mods */

// #define MAKE_RETRO_HRM(NAME, HOLD, TAP, RETRO, TRIGGER_POS) \
//     ZMK_HOLD_TAP(NAME, \
//         flavor = "balanced"; \
//         tapping-term-ms = <200>; \
//         quick-tap-ms = <200>; \
//         require-prior-idle-ms = <125>; \
//         bindings = <HOLD>, <TAP>; \
//         retro-tap; \
//         retro-tap-behavior = "key_press"; \
//         retro-tap-param1 = <RETRO>; \
//         hold-trigger-key-positions = <TRIGGER_POS>; \
//         hold-trigger-on-release; \
//     )

// MAKE_RETRO_HRM(hmrla, &kp, &kp, <LS(A)>, KEYS_R THUMBS) //left
// MAKE_RETRO_HRM(hmrls, &kp, &kp, <S>, KEYS_R THUMBS) //left
// MAKE_RETRO_HRM(hmrld, &kp, &kp, <D>, KEYS_R THUMBS) //left
// MAKE_RETRO_HRM(hmrlf, &kp, &kp, <F>, KEYS_R THUMBS) //left
// MAKE_RETRO_HRM(hmrrj, &kp, &kp, <J>, KEYS_L THUMBS) //right
// MAKE_RETRO_HRM(hmrrk, &kp, &kp, <K>, KEYS_L THUMBS) //right
// MAKE_RETRO_HRM(hmrrl, &kp, &kp, <L>, KEYS_L THUMBS) //right
// MAKE_RETRO_HRM(hmrrqt, &kp, &kp, <SQT>, KEYS_L THUMBS) //right

ZMK_HOLD_TAP(retro_a,
    flavor = "balanced";
    tapping-term-ms = <250>;
    quick-tap-ms = <200>; 
    bindings = <&kp>, <&kp>;
    retro-tap;
    retro-tap-behavior = "key_press";
    retro-tap-param1 = <LS(A)>;
    hold-trigger-key-positions = <RHKEYS THKEYS>;
    hold-trigger-on-release;
)
ZMK_HOLD_TAP(retro_s,
    flavor = "balanced";
    tapping-term-ms = <250>;
    quick-tap-ms = <200>; 
    bindings = <&kp>, <&kp>;
    retro-tap;
    retro-tap-behavior = "key_press";
    retro-tap-param1 = <LS(S)>;
    hold-trigger-key-positions = <RHKEYS THKEYS>;
    hold-trigger-on-release;
)
ZMK_HOLD_TAP(retro_d,
    flavor = "balanced";
    tapping-term-ms = <250>;
    quick-tap-ms = <200>; 
    bindings = <&kp>, <&kp>;
    retro-tap;
    retro-tap-behavior = "key_press";
    retro-tap-param1 = <LS(D)>;
    hold-trigger-key-positions = <RHKEYS THKEYS>;
    hold-trigger-on-release;
)
ZMK_HOLD_TAP(retro_f,
    flavor = "balanced";
    tapping-term-ms = <250>;
    quick-tap-ms = <200>; 
    bindings = <&kp>, <&kp>;
    retro-tap;
    retro-tap-behavior = "key_press";
    retro-tap-param1 = <LS(F)>;
    hold-trigger-key-positions = <RHKEYS THKEYS>;
    hold-trigger-on-release;
)
ZMK_HOLD_TAP(retro_j,
    flavor = "balanced";
    tapping-term-ms = <250>;
    quick-tap-ms = <200>; 
    bindings = <&kp>, <&kp>;
    retro-tap;
    retro-tap-behavior = "key_press";
    retro-tap-param1 = <LS(J)>;
    hold-trigger-key-positions = <LHKEYS THKEYS>;
    hold-trigger-on-release;
)
ZMK_HOLD_TAP(retro_k,
    flavor = "balanced";
    tapping-term-ms = <250>;
    quick-tap-ms = <200>; 
    bindings = <&kp>, <&kp>;
    retro-tap;
    retro-tap-behavior = "key_press";
    retro-tap-param1 = <LS(K)>;
    hold-trigger-key-positions = <LHKEYS THKEYS>;
    hold-trigger-on-release;
)
ZMK_HOLD_TAP(retro_l,
    flavor = "balanced";
    tapping-term-ms = <250>;
    quick-tap-ms = <200>; 
    bindings = <&kp>, <&kp>;
    retro-tap;
    retro-tap-behavior = "key_press";
    retro-tap-param1 = <LS(L)>;
    hold-trigger-key-positions = <LHKEYS THKEYS>;
    hold-trigger-on-release;
)
ZMK_HOLD_TAP(retro_qt,
    flavor = "balanced";
    tapping-term-ms = <250>;
    quick-tap-ms = <200>; 
    bindings = <&kp>, <&kp>;
    retro-tap;
    retro-tap-behavior = "key_press";
    retro-tap-param1 = <LS(SQT)>;
    hold-trigger-key-positions = <LHKEYS THKEYS>;
    hold-trigger-on-release;
)

/* Nav cluster */

// long-tap action on hold, short-tap action on all interrupts
#define MT_CORE \
    flavor = "tap-preferred"; \
    tapping-term-ms = <220>; \
    quick-tap-ms = <220>; \
    hold-trigger-key-positions = <0>;

&mt { MT_CORE };
ZMK_HOLD_TAP(mt_home, bindings = <&masked_home>, <&kp>; MT_CORE)
ZMK_HOLD_TAP(mt_end, bindings = <&masked_end>, <&kp>; MT_CORE)

#define NAV_LEFT  &mt_home 0   LEFT    // tap: left  | long-tap: beginning of line
#define NAV_RIGHT &mt_end 0    RIGHT   // tap: right | long-tap: end       of line
#define NAV_UP    &mt LC(HOME) UP      // tap: up    | long-tap: beginning of document
#define NAV_DOWN  &mt LC(END)  DOWN    // tap: down  | long-tap: end       of document
#define NAV_BSPC  &mt LC(BSPC) BSPC    // tap: bspc  | long-tap: delete word backward
#define NAV_DEL   &mt LC(DEL)  DEL     // tap: del   | long-tap: delete word forward

// mask CTRL when holding left/right to avoid accidental jumps to beginning/end of document
#define MASK_MODS(NAME, MODS, BINDING) \
    ZMK_MOD_MORPH(NAME, \
        bindings = <BINDING>, <BINDING>; \
        mods = <MODS>; \
    )
MASK_MODS(masked_home, (MOD_LCTL), &kp HOME)
MASK_MODS(masked_end,  (MOD_LCTL), &kp END)

/* Caps-word, num-word and smart-mouse */

// tap: sticky-shift | shift + tap/ double-tap: caps-word | hold: shift
ZMK_MOD_MORPH(smart_number,
    bindings = <&kp RET>, <&num_word U_NUM>;
    mods = <(MOD_LGUI)>;
)

// tap: sticky-shift | shift + tap/ double-tap: caps-word | hold: shift
ZMK_MOD_MORPH(smart_shft,
    bindings = <&sk LSHFT>, <&caps_word>;
    mods = <(MOD_LSFT)>;
)
&caps_word {  // mods deactivate caps-word, requires PR #1451
    /delete-property/ ignore-modifiers;
};

ZMK_MOD_MORPH(smart_nav,
    bindings = <&kp SPACE>, <&nav_word U_NAV>;
    mods = <(MOD_LGUI)>;
)


ZMK_TRI_STATE(smart_sym,
    bindings = <&tog U_SYM>, <&none>, <&tog U_SYM>;
    ignored-key-positions = <LT1 LT3 RT0 RT1 RT2 RT3 RT4 RM1 RM2 RM3 RM4 RB1 RB2 RB3 RH0 RH1 RH2>;
    ignored-layers = <U_SYM>;
)


ZMK_HOLD_TAP(smart_bkspace_sym,
    flavor = "tap-preferred";
    tapping-term-ms = <250>;
    quick-tap-ms = <200>;
    bindings = <&mo>, <&sym_bkspace_dance>;
)
ZMK_TAP_DANCE(sym_bkspace_dance,
    tapping-term-ms = <250>;
    bindings = <&kp BSPC>, <&smart_sym>;  // reverse this for sticky-num on single tap
)

// ZMK_TRI_STATE(smart_nav,
//     bindings = <&tog U_NAV>, <&none>, <&tog U_NAV>;
//     ignored-key-positions = <LT1 LT3 RT0 RT1 RT2 RT3 RT4 RM1 RM2 RM3 RM4 RB1 RB2 RB3 RH0 RH1 RH2>;
//     ignored-layers = <U_NAV>;
// )

ZMK_HOLD_TAP(smart_space_nav,
    flavor = "hold-preferred";
    tapping-term-ms = <250>;
    quick-tap-ms = <QUICK_TAP_MS>;
    bindings = <&mo>, <&smart_nav>;
)
ZMK_TAP_DANCE(nav_space_dance,
    tapping-term-ms = <250>;
    bindings = <&kp SPACE>, <&smart_nav>;  // reverse this for sticky-num on single tap
)

ZMK_TRI_STATE(smart_num,
    bindings = <&tog U_NUM>, <&none>, <&tog U_NUM>;
    ignored-key-positions = <LT1 LT3 RT0 RT1 RT2 RT3 RT4 RM1 RM2 RM3 RM4 RB1 RB2 RB3 RH0 RH1 RH2>;
    ignored-layers = <U_NUM>;
)

// tap: num-word | double-tap: sticky num-layer | hold: num-layer
ZMK_HOLD_TAP(smart_enter_num,
    flavor = "hold-preferred";
    tapping-term-ms = <250>;
    quick-tap-ms = <QUICK_TAP_MS>;
    bindings = <&mo>, <&smart_number>;
)
ZMK_TAP_DANCE(num_enter_dance,
    tapping-term-ms = <250>;
    bindings = <&kp RET>, <&smart_num>;  // reverse this for sticky-num on single tap
)

&num_word {
    continue-list = <BSPC DEL DOT COMMA PLUS MINUS STAR FSLH EQUAL UNDER LPAR RPAR LBRC RBRC LBKT RBKT>;
};

// &nav_word {
//     ignore-alphas;
//     continue-list = <LEFT RIGHT UP DOWN>;
//     layers = <U_NAV>;  // replace NUM by the location of numbers layerV
// };

 // ╭─────────────────────────╮               ╭─────────────────────────╮
 // │ LT5 LT4 LT3 LT2 LT1 LT0 │               │ RT0 RT1 RT2 RT3 RT4 RT5 │
 // │ LM5 LM4 LM3 LM2 LM1 LM0 ╰──╮         ╭──╯ RM0 RM1 RM2 RM3 RM4 RM5 │
 // │ LB5 LB4 LB3 LB2 LB1 LB0 LH4╰────┬────╯RH4 RB0 RB1 RB2 RB3 RB4 RB5 │
 // ╰───────────────╮ LH3 LH2 LH1 LH0 │ RH0 RH1 RH2 RH3 ╭───────────────╯
 //                 ╰─────────────────┴───── ───────────╯

// smart-mouse, requires PR #1366
ZMK_TRI_STATE(smart_mouse,
    bindings = <&tog U_MOUSE>, <&none>, <&tog U_MOUSE>;
    ignored-key-positions = <RHKEYS>;
    ignored-layers = <U_MOUSE>;
)

ZMK_HOLD_TAP(smart_tab_mouse,
    flavor = "balanced";
    tapping-term-ms = <200>;
    quick-tap-ms = <QUICK_TAP_MS>;
    bindings = <&mo>, <&mouse_tab_dance>;
)

ZMK_MOD_MORPH(mouse_tab_dance,
    bindings = <&kp TAB>, <&smart_mouse>;
    mods = <(MOD_LGUI)>;
)

ZMK_HOLD_TAP(esc_switch_copy,
    flavor = "balanced";
    tapping-term-ms = <200>;
    quick-tap-ms = <QUICK_TAP_MS>;
    bindings = <&kp>, <&esc_switch_copy_dance>;
)

ZMK_TAP_DANCE(esc_switch_copy_dance,
    tapping-term-ms = <200>;
    bindings = <&kp ESC>, <&kp LA(LS(C))>;
)

// #define SMART_NUM &smart_num NUM 0


ZMK_HOLD_TAP(gui_ray_switch,
    flavor = "balanced";
    tapping-term-ms = <250>;
    quick-tap-ms = <QUICK_TAP_MS>;
    bindings = <&kp>, <&gui_ray_switch_dance>;
)

ZMK_TAP_DANCE(gui_ray_switch_dance,
    tapping-term-ms = <200>;
    bindings = <&kp LC(SPACE)>, <&kp RG(LC(LA(TAB)))>;
)
 
/* Custom behaviors */

// Alt+Tab swapper, requires PR #1366
// ZMK_TRI_STATE(swapper,
//     bindings = <&kt LALT>, <&kp TAB>, <&kt LALT>;
//     ignored-key-positions = <LT2>;
// )

// Sticky layer + sticky shift (workaround for issue #1421)
// ZMK_STICKY_KEY(sls,
//     release-after-ms = <1000>;
//     bindings = <&uc_shift>;
//     ignore-modifiers;
// )
// ZMK_MACRO(uc_shift,
//     wait-ms = <0>;
//     tap-ms = <1>;
//     bindings = <&macro_press &mo UC &kp LSHFT>
//              , <&macro_pause_for_release>
//              , <&macro_release &mo UC &kp LSHFT>;
// )

// reuse basic mod-morph scheme
#define SIMPLE_MORPH(NAME, MOD, BINDING1, BINDING2) \
    ZMK_MOD_MORPH(NAME, \
        mods = <(MOD_L ## MOD|MOD_R ## MOD)>; \
        bindings = <BINDING1>, <BINDING2>; \
    )

// tap: comma | shift + tap: semicolon | ctrl + shift + tap: <
SIMPLE_MORPH(comma_morph, SFT, &kp COMMA, &comma_inner_morph)
SIMPLE_MORPH(comma_inner_morph, CTL, &kp SEMICOLON, &kp LESS_THAN)

// tap: dot | shift + tap: colon | ctrl + shift + tap: >
SIMPLE_MORPH(dot_morph, SFT, &kp DOT, &dot_inner_morph)
SIMPLE_MORPH(dot_inner_morph, CTL, &kp COLON, &kp GREATER_THAN)

// tap: qmark | shift + tap: excl
SIMPLE_MORPH(qexcl, SFT, &kp EXCL, &kp QMARK)

// tap: left/right parenthesis | shft + tap: less-than/greater-than
SIMPLE_MORPH(lpar_lt, SFT, &kp LPAR, &kp LT)
SIMPLE_MORPH(rpar_gt, SFT, &kp RPAR, &kp GT)


// tap: colon | shift + tap: semicolon | hold: activate layer
ZMK_HOLD_TAP(cln_fun,
    flavor = "balanced";
    tapping-term-ms = <200>;
    quick-tap-ms = <QUICK_TAP_MS>;
    bindings = <&mo>, <&flip_semi>;
)
SIMPLE_MORPH(cln_morph, SFT, &kp COLON, &kp SEMICOLON)


// tap: space | shift + tap: dot -> space -> sticky shift | hold: activate layer
ZMK_HOLD_TAP(lt_spc,
    flavor = "balanced";
    tapping-term-ms = <200>;
    quick-tap-ms = <QUICK_TAP_MS>;
    bindings = <&mo>, <&spc_morph>;
)
SIMPLE_MORPH(spc_morph, SFT, &kp SPACE, &dot_spc)
ZMK_MACRO(dot_spc,
    wait-ms = <0>;
    tap-ms = <5>;
    bindings = <&kp DOT &kp SPACE &sk LSHFT>;
)

// tap: backspace | lshft + tap: delete | rshft + tap: shift-delete
ZMK_MOD_MORPH(bs_del,
    bindings = <&kp BSPC>, <&kp DEL>;
    mods = <(MOD_LSFT|MOD_RSFT)>;
    keep-mods = <MOD_RSFT>;
)

// tap: copy | double-tap: cut
ZMK_TAP_DANCE(copy_cut,
    tapping-term-ms = <200>;
    bindings = <&kp LG(C)>, <&kp LG(X)>;
)

// tap: p | double-tap: del
ZMK_TAP_DANCE(p_del,
    tapping-term-ms = <200>;
    bindings = <&kp P>, <&kp DEL>;
)

ZMK_TAP_DANCE(esc_notes,
    tapping-term-ms = <250>;
    bindings = <&kp ESC>, <&kp LG(LS(N))>;
)
ZMK_TAP_DANCE(flip_semi,
    tapping-term-ms = <250>;
    bindings = <&kp COLON>, <&kp SEMI>;
)
ZMK_TAP_DANCE(alt_f12,
    tapping-term-ms = <250>;
    bindings = <&kp F12>, <&kp RALT>;
)
// Windows sleep key
ZMK_MACRO(win_sleep,
    wait-ms = <500>;
    tap-ms = <50>;
    bindings = <&kp LG(X) &kp U &kp S>;
)
&soft_off {
    hold-time-ms = <5000>; // Only turn off it the key is held for 5 seconds or longer.
};
// misc aliases
#define CANCEL      &kp K_CANCEL             // cancel caps-word, num-word and smart-mouse
#define DSK_PREV    &hmr LCTRL LG(LC(LEFT))   // previous desktop
#define DSK_NEXT    &hmr LALT LG(LC(RIGHT)) // next     desktop
#define PIN_WIN     &kp LG(LC(LS(Q)))        // pin window across desktops
#define PIN_APP     &kp LG(LC(LS(A)))        // pin application across desktops
#define DSK_MGR     &kp LA(GRAVE)            // desktop manager
#define VOL_DOWN    &hmr RSHFT C_VOL_DN


&mmv_input_listener {
    input-processors = <&zip_xy_scaler 3 1>;
}; 

