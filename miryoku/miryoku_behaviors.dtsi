// Copyright 2022 Manna Harbour
// https://github.com/manna-harbour/miryoku
// #define ZMK_HELPERS_KEEP_NATIVE 1
#include "../config/zmk-helpers/helper.h"
#include "../config/zmk-helpers/key-labels/hillside46.h"

#define KEYS_L LT0 LT1 LT2 LT3 LT4 LM0 LM1 LM2 LM3 LM4 LB0 LB1 LB2 LB3 LB4 // left-hand keys
#define KEYS_R RT0 RT1 RT2 RT3 RT4 RM0 RM1 RM2 RM3 RM4 RB0 RB1 RB2 RB3 RB4 // right-hand keys
#define THUMBS LH3 LH2 LH1 LH0 RH0 RH1 RH2 RH3                                      // thumb keys

#define QUICK_TAP_TERM 175
/*                                      46 KEY MATRIX / LAYOUT MAPPING

  ╭────────────────────────╮               ╭────────────────────────╮
  │  0   1   2   3   4   5 │               │  6   7   8   9  10  11 │
  │ 12  13  14  15  16  17 ╰──╮         ╭──╯ 18  19  20  21  22  23 │
  │ 24  25  26  27  28  29  30╰────┬────╯31  32  33  34  35  36  37 │
  ╰───────────────╮ 38  39  40  41 │ 42  43  44  45 ╭───────────────╯
                  ╰────────────────┴────────────────╯
 ╭─────────────────────────╮               ╭─────────────────────────╮
 │ LT5 LT4 LT3 LT2 LT1 LT0 │               │ RT0 RT1 RT2 RT3 RT4 RT5 │
 │ LM5 LM4 LM3 LM2 LM1 LM0 ╰──╮         ╭──╯ RM0 RM1 RM2 RM3 RM4 RM5 │
 │ LB5 LB4 LB3 LB2 LB1 LB0 LH4╰────┬────╯RH4 RB0 RB1 RB2 RB3 RB4 RB5 │
 ╰───────────────╮ LH3 LH2 LH1 LH0 │ RH0 RH1 RH2 RH3 ╭───────────────╯
                 ╰─────────────────┴───── ───────────╯
 T : Top
 M : Middle
 B : Bottom
 H : Hand
 P : Palm
*/

/*
#define HRC_TAB    &hml         LS(LALT) TAB
#define HRC_REPEAT &hml_repeat  LS(LCTRL) 0
#define HRC_LPAR   &hmr_lpar_lt RS(LCTRL) 0
#define HRC_RPAR   &hmr_rpar_gt RS(LALT) 0

//* Horizontal combos - left hand 
ZMK_COMBO(esc,   &kp ESC,       LT3 LT2,     DEF NAV NUM, COMBO_TERM_FAST, COMBO_IDLE_FAST)
ZMK_COMBO(ret,   &kp RETURN,    LT2 LT1,     DEF NAV NUM, COMBO_TERM_FAST, COMBO_IDLE_FAST)
ZMK_COMBO(mouse, &smart_mouse,  LT3 LT1,     DEF NAV NUM, COMBO_TERM_FAST, COMBO_IDLE_FAST)

ZMK_COMBO(tab,   HRC_TAB,       LM3 LM2,     DEF NAV NUM, COMBO_TERM_FAST, COMBO_IDLE_FAST)
ZMK_COMBO(repeat,HRC_REPEAT,    LM2 LM1,     DEF NAV NUM, COMBO_TERM_FAST, COMBO_IDLE_FAST)

ZMK_COMBO(cut,   &kp LC(X),     LB3 LB1,     DEF NAV NUM, COMBO_TERM_FAST, COMBO_IDLE_FAST)
ZMK_COMBO(copy,  &kp LC(INS),   LB3 LB2,     DEF NAV NUM, COMBO_TERM_FAST, COMBO_IDLE_FAST)
ZMK_COMBO(paste, &kp LS(INS),   LB2 LB1,     DEF NAV NUM, COMBO_TERM_FAST, COMBO_IDLE_FAST)

// Horizontal combos - right hand 
ZMK_COMBO(bspc,  &kp BSPC,      RT1 RT2,     DEF NAV NUM, COMBO_TERM_FAST, COMBO_IDLE_FAST)
ZMK_COMBO(del,   &kp DEL,       RT2 RT3,     DEF NAV NUM, COMBO_TERM_FAST, COMBO_IDLE_FAST)

ZMK_COMBO(lpar,  HRC_LPAR,      RM1 RM2,     DEF     NUM, COMBO_TERM_FAST, COMBO_IDLE_FAST)
ZMK_COMBO(rpar,  HRC_RPAR,      RM2 RM3,     DEF     NUM, COMBO_TERM_FAST, COMBO_IDLE_FAST)
ZMK_COMBO(lt,    &kp LT,        RM1 RM2,         NAV    , COMBO_TERM_FAST, COMBO_IDLE_FAST)
ZMK_COMBO(gt,    &kp GT,        RM2 RM3,         NAV    , COMBO_TERM_FAST, COMBO_IDLE_FAST)

ZMK_COMBO(lbkt,  &kp LBKT,      RB1 RB2,     DEF     NUM, COMBO_TERM_FAST, COMBO_IDLE_FAST)
ZMK_COMBO(rbkt,  &kp RBKT,      RB2 RB3,     DEF     NUM, COMBO_TERM_FAST, COMBO_IDLE_FAST)
ZMK_COMBO(lbrc,  &kp LBRC,      RB1 RB2,         NAV    , COMBO_TERM_FAST, COMBO_IDLE_FAST)
ZMK_COMBO(rbrc,  &kp RBRC,      RB2 RB3,         NAV    , COMBO_TERM_FAST, COMBO_IDLE_FAST)

ZMK_COMBO(grk,   &sl UC,        RT1 RT3,     DEF NAV NUM, COMBO_TERM_FAST, COMBO_IDLE_FAST)
ZMK_COMBO(cpgrk, &sls 0,        RT1 RT2 RT3, DEF NAV NUM, COMBO_TERM_FAST, COMBO_IDLE_FAST)

// Vertical combos - left hand 
ZMK_COMBO(at,    &kp AT,        LT3 LM3,     DEF NAV NUM, COMBO_TERM_SLOW, COMBO_IDLE_SLOW)
ZMK_COMBO(hash,  &kp HASH,      LT2 LM2,     DEF NAV NUM, COMBO_TERM_SLOW, COMBO_IDLE_SLOW)
ZMK_COMBO(dllr,  &kp DLLR,      LT1 LM1,     DEF NAV NUM, COMBO_TERM_SLOW, COMBO_IDLE_SLOW)
ZMK_COMBO(prcnt, &kp PRCNT,     LT0 LM0,     DEF NAV NUM, COMBO_TERM_SLOW, COMBO_IDLE_SLOW)

ZMK_COMBO(grave, &kp GRAVE,     LM3 LB3,     DEF NAV NUM, COMBO_TERM_SLOW, COMBO_IDLE_SLOW)
ZMK_COMBO(bslh,  &kp BSLH,      LM2 LB2,     DEF NAV NUM, COMBO_TERM_SLOW, COMBO_IDLE_SLOW)
ZMK_COMBO(equal, &kp EQUAL,     LM1 LB1,     DEF NAV NUM, COMBO_TERM_SLOW, COMBO_IDLE_SLOW)
ZMK_COMBO(tilde, &kp TILDE,     LM0 LB0,     DEF NAV NUM, COMBO_TERM_SLOW, COMBO_IDLE_SLOW)

// Vertical combos - right hand 
ZMK_COMBO(caret, &kp CARET,     RT0 RM0,     DEF NAV NUM, COMBO_TERM_SLOW, COMBO_IDLE_SLOW)
ZMK_COMBO(plus,  &kp PLUS,      RT1 RM1,     DEF NAV NUM, COMBO_TERM_SLOW, COMBO_IDLE_SLOW)
ZMK_COMBO(star,  &kp STAR,      RT2 RM2,     DEF NAV NUM, COMBO_TERM_SLOW, COMBO_IDLE_SLOW)
ZMK_COMBO(amps,  &kp AMPS,      RT3 RM3,     DEF NAV NUM, COMBO_TERM_SLOW, COMBO_IDLE_SLOW)

ZMK_COMBO(under, &kp UNDER,     RM0 RB0,     DEF NAV NUM, COMBO_TERM_SLOW, COMBO_IDLE_SLOW)
ZMK_COMBO(minus, &kp MINUS,     RM1 RB1,     DEF NAV NUM, COMBO_TERM_SLOW, COMBO_IDLE_SLOW)
ZMK_COMBO(fslh,  &kp FSLH,      RM2 RB2,     DEF NAV NUM, COMBO_TERM_SLOW, COMBO_IDLE_SLOW)
ZMK_COMBO(pipe,  &kp PIPE,      RM3 RB3,     DEF NAV NUM, COMBO_TERM_SLOW, COMBO_IDLE_SLOW)
*/


//
// ZMK_COMBO(cmb_cap_y,  &kp LS(Y), 16 6, U_BASE, COMBO_TERM_SLOW)
// ZMK_COMBO(cmb_cap_u,  &kp LS(U), 16 7, U_BASE, COMBO_TERM_SLOW)
// ZMK_COMBO(cmb_cap_i,  &kp LS(I), 16 8, U_BASE, COMBO_TERM_SLOW)
// ZMK_COMBO(cmb_cap_o,  &kp LS(O), 16 9, U_BASE, COMBO_TERM_SLOW)
// ZMK_COMBO(cmb_cap_p,  &kp LS(P), 16 10, U_BASE, COMBO_TERM_SLOW)
// ZMK_COMBO(cmb_cap_h,  &kp LS(H), 16 18, U_BASE, COMBO_TERM_SLOW)
// // ZMK_COMBO(cmb_cap_j,  &kp LS(J), 16 19, U_BASE, COMBO_TERM_SLOW)
// ZMK_COMBO(cmb_cap_k,  &kp LS(K), 16 20, U_BASE, COMBO_TERM_SLOW)
// ZMK_COMBO(cmb_cap_l,  &kp LS(L), 16 21, U_BASE, COMBO_TERM_SLOW)
// ZMK_COMBO(cmb_cap_quot,  &kp LS(SQT), 16 22, U_BASE, COMBO_TERM_SLOW)
// ZMK_COMBO(cmb_cap_n,  &kp LS(N), 16 32, U_BASE, COMBO_TERM_SLOW)
// ZMK_COMBO(cmb_cap_m,  &kp LS(M), 16 33, U_BASE, COMBO_TERM_SLOW)
// ZMK_COMBO(cmb_cap_comma,  &kp LS(COMMA), 16 34, U_BASE, COMBO_TERM_SLOW)
// ZMK_COMBO(cmb_cap_dot,  &kp LS(DOT), 16 35, U_BASE, COMBO_TERM_SLOW)
// ZMK_COMBO(cmb_cap_slash,  &kp LS(SLASH), 16 36, U_BASE, COMBO_TERM_SLOW)
// ZMK_COMBO(cmb_cap_colon,  &kp LS(SEMI), 16 45, U_BASE, COMBO_TERM_SLOW)
//
// ZMK_COMBO(cmb_cap_q,  &kp LS(Q), 19 1, U_BASE, COMBO_TERM_SLOW)
// ZMK_COMBO(cmb_cap_w,  &kp LS(W), 19 2, U_BASE, COMBO_TERM_SLOW)
// ZMK_COMBO(cmb_cap_e,  &kp LS(E), 19 3, U_BASE, COMBO_TERM_SLOW)
// ZMK_COMBO(cmb_cap_r,  &kp LS(R), 19 4, U_BASE, COMBO_TERM_SLOW)
// ZMK_COMBO(cmb_cap_t,  &kp LS(T), 19 5, U_BASE, COMBO_TERM_SLOW)
// ZMK_COMBO(cmb_cap_a,  &kp LS(A), 19 13, U_BASE, COMBO_TERM_SLOW)
// ZMK_COMBO(cmb_cap_s,  &kp LS(S), 19 14, U_BASE, COMBO_TERM_SLOW)
// ZMK_COMBO(cmb_cap_d,  &kp LS(D), 19 15, U_BASE, COMBO_TERM_SLOW)
// ZMK_COMBO(cmb_cap_f,  &kp LS(F), 19 16, U_BASE, COMBO_TERM_SLOW)
// ZMK_COMBO(cmb_cap_g,  &kp LS(G), 19 17, U_BASE, COMBO_TERM_SLOW)
// ZMK_COMBO(cmb_cap_z,  &kp LS(Z), 19 25, U_BASE, COMBO_TERM_SLOW)
// ZMK_COMBO(cmb_cap_x,  &kp LS(X), 19 26, U_BASE, COMBO_TERM_SLOW)
// ZMK_COMBO(cmb_cap_c,  &kp LS(C), 19 27, U_BASE, COMBO_TERM_SLOW)
// ZMK_COMBO(cmb_cap_v,  &kp LS(V), 19 28, U_BASE, COMBO_TERM_SLOW)
// ZMK_COMBO(cmb_cap_b,  &kp LS(B), 19 29, U_BASE, COMBO_TERM_SLOW)
// ZMK_COMBO(cmb_cap_grave,  &kp LS(GRAVE), 19 38, U_BASE, COMBO_TERM_SLOW)
//
/ {
  behaviors {
    // hrasA: hrasA {
    //     compatible = "zmk,behavior-hold-tap";
    //     label = "hrasA";
    //     #binding-cells = <2>;
    //     flavor = "balanced";
    //     tapping-term-ms = <250>;
    //     quick-tap-ms = <QUICK_TAP_TERM>;
    //     bindings = <&kp>, <&kp>;
    //     hold-trigger-on-release;             // delay positional check until key-release
    //     retro-tap;
    // };
    // hrasS: hrasS {
    //     compatible = "zmk,behavior-hold-tap";
    //     label = "hrasS";
    //     #binding-cells = <2>;
    //     flavor = "balanced";
    //     tapping-term-ms = <250>;
    //     quick-tap-ms = <QUICK_TAP_TERM>;
    //     bindings = <&kp>, <&kp>;
    //     hold-trigger-on-release;             // delay positional check until key-release
    //     retro-tap;
    // };
    // hrasD: hrasD {
    //     compatible = "zmk,behavior-hold-tap";
    //     label = "hrasD";
    //     #binding-cells = <2>;
    //     flavor = "balanced";
    //     tapping-term-ms = <250>;
    //     quick-tap-ms = <QUICK_TAP_TERM>;
    //     bindings = <&kp>, <&kp>;
    //     hold-trigger-on-release;             // delay positional check until key-release
    //     retro-tap;
    // };
    // hrasF: hrasF {
    //     compatible = "zmk,behavior-hold-tap";
    //     label = "hrasF";
    //     #binding-cells = <2>;
    //     flavor = "balanced";
    //     tapping-term-ms = <250>;
    //     quick-tap-ms = <QUICK_TAP_TERM>;
    //     hold-trigger-on-release;             // delay positional check until key-release
    //     bindings = <&kp>, <&kp>;
    //     retro-tap;
    // };
    // hrasJ: hrasJ {
    //     compatible = "zmk,behavior-hold-tap";
    //     label = "hrasJ";
    //     #binding-cells = <2>;
    //     flavor = "balanced";
    //     tapping-term-ms = <250>;
    //     quick-tap-ms = <QUICK_TAP_TERM>;
    //     bindings = <&kp>, <&kp>;
    //     hold-trigger-on-release;             // delay positional check until key-release
    //     retro-tap;
    // };
    // hrasK: hrasK {
    //     compatible = "zmk,behavior-hold-tap";
    //     label = "hrasK";
    //     #binding-cells = <2>;
    //     flavor = "balanced";
    //     tapping-term-ms = <250>;
    //     quick-tap-ms = <QUICK_TAP_TERM>;
    //     bindings = <&kp>, <&kp>;
    //     hold-trigger-on-release;             // delay positional check until key-release
    //     retro-tap;
    // };
    // hrasL: hrasL {
    //     compatible = "zmk,behavior-hold-tap";
    //     label = "hrasL";
    //     #binding-cells = <2>;
    //     flavor = "balanced";
    //     tapping-term-ms = <250>;
    //     quick-tap-ms = <QUICK_TAP_TERM>;
    //     bindings = <&kp>, <&kp>;
    //     hold-trigger-on-release;             // delay positional check until key-release
    //     retro-tap;
    // };
    // hrasSQT: hrasSQT {
    //     compatible = "zmk,behavior-hold-tap";
    //     label = "hrasSQT";
    //     #binding-cells = <2>;
    //     flavor = "balanced";
    //     tapping-term-ms = <250>;
    //     quick-tap-ms = <QUICK_TAP_TERM>;
    //     bindings = <&kp>, <&kp>;
    //     hold-trigger-on-release;             // delay positional check until key-release
    //     retro-tap;
    // };
    // clnasFN: clnasFN {
    //     compatible = "zmk,behavior-hold-tap";
    //     label = "clnasFN";
    //     #binding-cells = <2>;
    //     flavor = "balanced";
    //     tapping-term-ms = <175>;
    //     quick-tap-ms = <QUICK_TAP_TERM>;
    //     bindings = <&mo>, <&kp>;
    //     retro-tap;
    //     hold-trigger-on-release;             // delay positional check until key-release
    // };
    u_mt_z: u_mt_z {
      compatible = "zmk,behavior-hold-tap";
      label = "u_mt_z";
      #binding-cells = <2>;
      tapping_term_ms = <U_TAPPING_TERM>;
      quick-tap-ms = <175>;
      require-prior-idle-ms = <150>;
      flavor = "hold-preferred";
      bindings = <&kp>, <&sk>;
    };
    // u_mt_z: u_mt_z {
    //   compatible = "zmk,behavior-hold-tap";
    //   label = "u_mt_z";
    //   #binding-cells = <2>;
    //   tapping_term_ms = <225>;
    //   quick-tap-ms = <200>;
    //   global-quick-tap-ms = <200>;
    //   require-prior-idle-ms = <175>;
    //   flavor = "tap-preferred";
    //   bindings = <&kp>, <&kp>;
    //   hold-trigger-key-positions = <0>;
    // };
    u_mt: u_mt {
      compatible = "zmk,behavior-hold-tap";
      label = "u_mt";
      #binding-cells = <2>;
      tapping_term_ms = <U_TAPPING_TERM>;
      quick-tap-ms = <175>;
      require-prior-idle-ms = <150>;
      flavor = "hold-preferred";
      bindings = <&kp>, <&kp>;
    };
    u_ltnum: u_ltnum {
      compatible = "zmk,behavior-hold-tap";
      label = "u_ltnum";
      #binding-cells = <2>;
      tapping_term_ms = <U_TAPPING_TERM>;
      flavor = "hold-preferred";
      bindings = <&mo>, <&kp>;
    };
    u_lt: u_lt {
      compatible = "zmk,behavior-hold-tap";
      label = "u_lt";
      #binding-cells = <2>;
      quick-tap-ms = <175>;
      tapping_term_ms = <U_TAPPING_TERM>;
      flavor = "hold-preferred";
      bindings = <&mo>, <&kp>;
    };
    u_bp: u_bp {
        compatible = "zmk,behavior-tap-dance";
        label = "u_bp";
        #binding-cells = <0>;
        tapping-term-ms = <350>;
        bindings = <&kp LG(LBKT)>, <&kp LG(PIPE)>;
    };
    u_bf: u_bf {
        compatible = "zmk,behavior-tap-dance";
        label = "u_bf";
        #binding-cells = <0>;
        tapping-term-ms = <350>;
        bindings = <&kp LG(LBKT)>, <&kp LG(RBKT)>, <&kp LG(PIPE)>;
    };
    u_fp: u_fp {
        compatible = "zmk,behavior-tap-dance";
        label = "u_fp";
        #binding-cells = <0>;
        tapping-term-ms = <350>;
        bindings = <&kp LG(RBKT)>, <&kp LG(PIPE)>;
    };
    bp_wrap: bp_wrap {
        compatible = "zmk,behavior-hold-tap";
        label = "bp_wrap";
        #binding-cells = <2>;
        tapping_term_ms = <250>;
        flavor = "balanced";
        bindings = <&kp>, <&u_bp>;
    };
    fp_wrap: fp_wrap {
        compatible = "zmk,behavior-hold-tap";
        label = "fp_wrap";
        #binding-cells = <2>;
        tapping_term_ms = <250>;
        flavor = "balanced";
        bindings = <&kp>, <&u_fp>;
    };
    ray_dance_wrap: ray_dance_wrap {
        compatible = "zmk,behavior-hold-tap";
        label = "ray_dance_wrap";
        #binding-cells = <2>;
        tapping-term-ms = <250>;
        flavor = "balanced";
        bindings = <&kp>, <&ray_dance>;
    };
    ray_dance: ray_dance {
        compatible = "zmk,behavior-tap-dance";
        label = "ray_dance";
        #binding-cells = <0>;
        tapping-term-ms = <350>;
        bindings = <&kp LC(SPACE)>, <&swapper>;
    };
    u_ray: u_ray {
        compatible = "zmk,behavior-tap-dance";
        label = "u_ray";
        #binding-cells = <0>;
        tapping-term-ms = <350>;
        bindings = <&kp LS(LG(SPACE))>, <&kp LA(TAB)>;
    };
    ray_wrap: ray_wrap {
        compatible = "zmk,behavior-hold-tap";
        label = "RAY_WRAP";
        #binding-cells = <2>;
        tapping_term_ms = <250>;
        flavor = "balanced";
        bindings = <&kp>, <&kp>;
    };
    u_esc_caps: u_esc_caps {
        compatible = "zmk,behavior-tap-dance";
        label = "U_ESC_CAPS";
        #binding-cells = <0>;
        tapping-term-ms = <200>;
        bindings = <&kp ESC>, <&u_caps_word>;
    };
    shft_num_word: shft_num_word {
        compatible = "zmk,behavior-hold-tap";
        label = "SHFT_NUM_WORD";
        #binding-cells = <2>;
        tapping_term_ms = <250>;
        flavor = "hold-preferred";
        bindings = <&kp>, <&swapper>;
    };
    shft_caps_word: shft_caps_word {
        compatible = "zmk,behavior-hold-tap";
        label = "SHFT_CAPS_WORD";
        #binding-cells = <2>;
        tapping_term_ms = <250>;
        flavor = "hold-preferred";
        bindings = <&kp>, <&kp>;
    };
    u_sym_bspc: u_sym_bspc {
        compatible = "zmk,behavior-tap-dance";
        label = "u_sym_bspc";
        #binding-cells = <0>;
        tapping-term-ms = <10>;
        bindings = <&kp BSPC>, <&kp BSPC>;
    };
    sym_bspc_wrap: sym_bspc_wrap {
        compatible = "zmk,behavior-hold-tap";
        label = "SYM_BSPC_WRAP";
        #binding-cells = <2>;
        tapping_term_ms = <550>;
        flavor = "balanced";
        bindings = <&mo>, <&u_sym_bspc>;
    };
    u_zoom: u_zoom {
        compatible = "zmk,behavior-tap-dance";
        label = "u_zoom";
        #binding-cells = <0>;
        tapping-term-ms = <200>;
        bindings = <&kp LS(LG(A))>, <&kp LS(LG(V))>;
    };
    as: auto_shift {
        compatible = "zmk,behavior-hold-tap";
        label = "AUTO_SHIFT";
        #binding-cells = <2>;
        tapping_term_ms = <250>;
        quick_tap_ms = <QUICK_TAP_TERM>;
        flavor = "tap-preferred";
        bindings = <&kp>, <&kp>;
    };
    // nst: nav_shift_tap {
    //     compatible = "zmk,behavior-hold-tap";
    //     label = "SHIFT_SPACE";
    //     #binding-cells = <2>;
    //     tapping_term_ms = <200>;
    //     quick_tap_ms = <150>;
    //     global-quick-tap;
    //     flavor = "tap-preferred";
    //     bindings = <&s_nav_wrap>, <&kp>;
    // };
    // s_nav: shift_nav {
    //     compatible = "zmk,behavior-hold-tap";
    //     label = "SHIFT_NAV";
    //     #binding-cells = <2>;
    //     tapping_term_ms = <200>;
    //     global-quick-tap;
    //     flavor = "tap-preferred";
    //     bindings = <&mo_nav>, <&kp_shift>;
    // };
    space_nav_tap: space_nav_tap {
        compatible = "zmk,behavior-tap-dance";
        label = "space_nav_tap";
        #binding-cells = <0>;
        tapping-term-ms = <300>;
        bindings = <&kp SPACE>, <&tog U_NAV>;
    };
    s_n_s: shift_nav_space {
        compatible = "zmk,behavior-hold-tap";
        label = "SHIFT_NAV_SPACE";
        #binding-cells = <2>;
        tapping-term-ms = <150>;
        quick_tap_ms = <100>;
        flavor = "balanced";
        bindings = <&kp>, <&kp>;
        retro-tap;
    };
    col_semi: colon_semicolon {
        compatible = "zmk,behavior-mod-morph";
        label = "COLON_SEMICOLON";
        #binding-cells = <0>;
        bindings = <&kp COLON>, <&kp SEMI>;
        mods = <(MOD_LSFT|MOD_RSFT)>;
    };
  };
  // macros {
  //   mo_nav: mo_nav {
  //       label = "mo_nav";
  //       compatible = "zmk,behavior-macro";
  //       #binding-cells = <0>;
  //       bindings
  //           = <&macro_press &mo U_NAV>
  //           , <&macro_pause_for_release>
  //           , <&macro_release &mo U_NAV>
  //           ;
  //   };
  //   kp_shift: kp_shift {
  //       label = "kp_shift";
  //       compatible = "zmk,behavior-macro";
  //       #binding-cells = <0>;
  //       bindings
  //           = <&macro_press &kp LSHFT>
  //           , <&macro_pause_for_release>
  //           , <&macro_release &kp LSHFT>
  //           ;
  //   };
  //   s_nav_wrap: s_nav_wrap {
  //       label = "s_nav_wrap";
  //       compatible = "zmk,behavior-macro";
  //       #binding-cells = <0>;
  //       bindings
  //           = <&macro_press &s_nav U_NAV LSHFT>
  //           , <&macro_pause_for_release>
  //           , <&macro_release &s_nav U_NAV LSHFT>
  //           ;
  //   };
  // };
};

ZMK_BEHAVIOR(u_hml, hold_tap,
    flavor = "balanced";
    tapping-term-ms = <280>;
    quick-tap-ms = <175>;                // repeat on tap-into-hold
    require-prior-idle-ms = <150>;         // requires PR #1387
    bindings = <&kp>, <&kp>;
    hold-trigger-key-positions = <KEYS_R THUMBS>;
    hold-trigger-on-release;             // delay positional check until key-release
)

/* right-hand HRMs */
ZMK_BEHAVIOR(u_hmr, hold_tap,
    flavor = "balanced";
    tapping-term-ms = <280>;
    quick-tap-ms = <175>;                // repeat on tap-into-hold
    require-prior-idle-ms = <150>;         // requires PR #1387
    bindings = <&kp>, <&kp>;
    hold-trigger-key-positions = <KEYS_L THUMBS>;
    hold-trigger-on-release;             // delay positional check until key-release
)


ZMK_BEHAVIOR(u_back_pipe, tap_dance,
    tapping-term-ms = <275>;
    bindings = <&kp LG(LBKT)>, <&kp LG(PIPE)>;
)

ZMK_BEHAVIOR(u_fwd_pipe, tap_dance,
    tapping-term-ms = <275>;
    bindings = <&kp LG(RBKT)>, <&kp LG(PIPE)>;
)


ZMK_BEHAVIOR(space_caps_word, tap_dance,
    tapping-term-ms = <280>;
    bindings = <&kp SPACE>, <&u_caps_word>;
)

ZMK_BEHAVIOR(parens, tap_dance,
    tapping-term-ms = <250>;
    bindings = <&kp LPAR>, <&kp RPAR>;
)


ZMK_BEHAVIOR(bksp_p, tap_dance,
    tapping-term-ms = <200>;
    bindings = <&kp P>, <&kp BSPC>;
)

ZMK_BEHAVIOR(esc_q, tap_dance,
    tapping-term-ms = <200>;
    bindings = <&kp Q>, <&kp ESC>;
)

// ZMK_BEHAVIOR(sticky_helper, macro,
//     wait-ms = <0>;
//     tap-ms = <0>;
//     bindings = <&kp SPACE &macro_tap_time 150 &sl 1>;
// )

ZMK_BEHAVIOR(ht2, hold_tap,
    tapping-term-ms = <50>;
    quick-tap-ms = <975>;                // repeat on tap-into-hold
    bindings = <&kp>, <&kp>;
)

&caps_word {
    continue-list = <BSPC DEL DOT COMMA FSLH EQUAL UNDER MINUS SPACE>;
};

&num_word {
    continue-list = <BSPC DEL DOT COMMA PLUS MINUS STAR FSLH EQUAL UNDER LPAR RPAR LBRC RBRC LBKT RBKT>;
    layers = <U_NUM>;  // replace NUM by the location of numbers layer
};

&sk {
    release-after-ms = <2000>;
    quick-release;
};

ZMK_BEHAVIOR(asn, hold_tap,
    flavor = "tap-preferred";
    tapping-term-ms = <250>;
    bindings = <&kp>, <&kp>;
)

ZMK_BEHAVIOR(nc_word, tap_dance,
    tapping-term-ms = <250>;
    bindings = <&u_caps_word>, <&num_word>;
)

ZMK_BEHAVIOR(none_caps_word, tap_dance,
    tapping-term-ms = <250>;
    bindings = <&u_caps_word>, <&rev_swapper>;
)

ZMK_BEHAVIOR(none_num_word, tap_dance,
    tapping-term-ms = <250>;
    bindings = <&num_word>, <&swapper>;
)

ZMK_BEHAVIOR(u_h_h, tap_dance,
    tapping-term-ms = <275>;
    bindings = <&kp H>,<&kp LC(H)>;
)

ZMK_BEHAVIOR(u_o_o, tap_dance,
    tapping-term-ms = <275>;
    bindings = <&kp O>,<&kp LC(O)>;
)

ZMK_BEHAVIOR(u_t_t, tap_dance,
    tapping-term-ms = <275>;
    bindings = <&kp T>,<&kp LC(T)>;
)

ZMK_BEHAVIOR(u_p_p, tap_dance,
    tapping-term-ms = <275>;
    bindings = <&kp P>,<&kp LC(P)>;
)

ZMK_BEHAVIOR(u_n_n, tap_dance,
    tapping-term-ms = <275>;
    bindings = <&kp N>,<&kp LC(N)>;
)

ZMK_BEHAVIOR(u_s_s, tap_dance,
    tapping-term-ms = <275>;
    bindings = <&kp S>,<&kp LC(S)>;
)

ZMK_BEHAVIOR(u_left, tap_dance,
    tapping-term-ms = <150>;
    bindings = <&kp LA(LEFT)>,<&kp LG(LEFT)>;
)

ZMK_BEHAVIOR(u_right, tap_dance,
    tapping-term-ms = <150>;
    bindings = <&kp LA(RIGHT)>,<&kp LG(RIGHT)>;
)
// ZMK_COMBO(cmb_lshft,  &kp LSHFT, 30 40, U_BASE)
// ZMK_COMBO(cmb_rshft,  &kp RSHFT, 31 43, U_BASE)
// ZMK_COMBO(cmb_capword,  &u_caps_word, 12 40, U_BASE)
// ZMK_COMBO(cmb_numword,  &num_word, 23 43, U_BASE)
ZMK_COMBO(cmb_alt_gui_hint,  &kp LA(LG(H)), 40 43, U_BASE, COMBO_IDLE_FAST)
ZMK_COMBO(cmb_alt_gui_grid,  &kp LA(LG(G)), 30 31, U_BASE, COMBO_IDLE_FAST)
//ZMK_COMBO(cmb_soft_off,  &soft_off, 24 37, U_BASE, COMBO_IDLE_FAST)
//
ZMK_COMBO(cmb_cmd_sht_main,  &kp LS(LGUI), 41 42, U_BASE, COMBO_IDLE_FAST)
// ZMK_COMBO(cmb_cmd_sht,  &kp LS(LGUI), 13 16, U_BASE )
// ZMK_COMBO(cmb_sht_cmd,  &kp LS(LGUI), 19 22, U_BASE)
//
// ZMK_COMBO(cmb_alt_sht,  &kp LS(LALT), 14 16, U_BASE)
// ZMK_COMBO(cmb_sht_alt,  &kp LS(LALT), 19 21, U_BASE)
//
// ZMK_COMBO(cmb_ctrl_sht,  &kp LS(LCTRL), 15 16, U_BASE)
// ZMK_COMBO(cmb_sht_ctrl,  &kp LS(LCTRL), 19 20, U_BASE)



// ZMK_COMBO(cmb_mouse,  &smart_mouse, LM1 LM0, U_NAV U_NUM U_BASE)
// ZMK_COMBO(mouse, &smart_mouse,  LT3 LT1,     U_BASE U_NAV U_NUM, COMBO_TERM_FAST, COMBO_IDLE_FAST)


// Alt+Tab swapper, requires PR #1366


ZMK_BEHAVIOR(swapper, tri_state,
    bindings = <&kt LCMD>, <&kp TAB>, <&kt LCMD>;
    ignored-key-positions = <LM5>;
)

ZMK_BEHAVIOR(rev_swapper, tri_state,
    bindings = <&kt LS(LCMD)>, <&kp TAB>, <&kt LS(LCMD)>;
)

